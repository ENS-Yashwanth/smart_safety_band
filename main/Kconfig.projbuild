## main/Kconfig.projbuild
```kconfig
menu "Smart Safety Band configuration"

    config SAFETY_BAND_SOS_GPIO
        int "SOS push-button GPIO"
        range 0 48
        default 4
        help
            GPIO wired to the emergency push button. The reference design uses
            an active-low button with the internal pull-up enabled.

    config SAFETY_BAND_MOTION_INT_GPIO
        int "Motion interrupt GPIO"
        range 0 48
        default 2
        help
            Reserved for the accelerometer interrupt on the GL868 reference
            board. The current motion task polls at 20 ms.

    config SAFETY_BAND_SIMULATION
        bool "Simulate missing health and environment sensors"
        default n
        help
            Allows real-time firmware development before optional modules are
            available. The real accelerometer is always preferred; only absent
            health/environment modules produce clearly labelled simulated data.

    config SAFETY_BAND_EMERGENCY_CALL_NUMBER
        string "Emergency call number"
        default "+917075834906"
        help
            Phone number to dial when an SOS emergency is activated.

    config SAFETY_BAND_EMERGENCY_SMS_NUMBER
        string "Emergency SMS number(s)"
        default "+917075834906"
        help
            Recipient number for SOS SMS alerts. Separate multiple numbers with
            commas or semicolons.

    config SAFETY_BAND_GPRS_APN
        string "GPRS APN"
        default "airtel.in"
        help
            APN supplied by the SIM provider. The GeoLinker reference SIM uses iot.com.

    config SAFETY_BAND_HTTP_UPLOAD
        bool "Upload GPS telemetry over GPRS"
        default y
        help
            Opens a GPRS bearer and sends JSON telemetry packets through the
            SIM868 HTTP client whenever a GPS upload event is processed.

    config SAFETY_BAND_HTTP_URL
        string "HTTP telemetry endpoint"
        default "http://yeswanth-tetsing.free.beeceptor.com"
        #default "http://qtc693f0d3f5cf15a2f982f7fcca.free.beeceptor.com/api/v1/events/normalized"
        #default "http://echo.free.beeceptor.com"
        depends on SAFETY_BAND_HTTP_UPLOAD
        help
            HTTP or HTTPS URL to receive normalized smart-band events.
            For the local demo, target the command-center ingestion proxy.

    config SAFETY_BAND_HTTP_DEVICE_ID
        string "HTTP telemetry device ID"
        default "smart_safety_band_001"
        depends on SAFETY_BAND_HTTP_UPLOAD
        help
            Stable band identifier included in each smart-band event packet.

    config SAFETY_BAND_CALL_RECORDING_SECONDS
        int "Answered SOS call recording duration (seconds)"
        range 5 60
        default 10
        help
            Duration of the temporary AMR call recording. The modem ends the
            call after recording because SIM868 is a GPRS class-B device and
            cannot upload GPRS data while the voice call remains active.

    config SAFETY_BAND_AUDIO_UPLOAD_CHUNK_BYTES
        int "AMR bytes per HTTPS JSON chunk"
        range 256 2048
        default 1024
        help
            Raw AMR bytes in each Base64-encoded JSON packet. Smaller chunks
            keep the SIM868 HTTPDATA payload safely below its practical limit.

    config SAFETY_BAND_GEOLINKER_API_KEY
        string "GeoLinker API key"
        default "cd_yas_200726_OZz8YT"
        help
            API key created in the CircuitDigest Cloud GeoLinker dashboard.

    config SAFETY_BAND_GEOLINKER_DEVICE_ID
        string "GeoLinker device ID"
        default "SMART_SAFETY_BAND_001"
        help
            Device identifier shown in the GeoLinker dashboard.

endmenu
```

## sdkconfig.defaults
```kconfig
CONFIG_IDF_TARGET="esp32s3"
CONFIG_ESPTOOLPY_FLASHSIZE_4MB=y
CONFIG_SAFETY_BAND_GPRS_APN="airtel.in"
CONFIG_SAFETY_BAND_HTTP_UPLOAD=y
#CONFIG_SAFETY_BAND_HTTP_URL="http://my-esp32-test.free.beeceptor.com"
CONFIG_SAFETY_BAND_HTTP_URL="http://my-esp32-test.free.beeceptor.com/api/v1/events/normalized"
#CONFIG_SAFETY_BAND_HTTP_URL="http://echo.free.beeceptor.com"
CONFIG_SAFETY_BAND_HTTP_DEVICE_ID="smart_safety_band_001"
CONFIG_SAFETY_BAND_CALL_RECORDING_SECONDS=10
CONFIG_SAFETY_BAND_AUDIO_UPLOAD_CHUNK_BYTES=1024
```
